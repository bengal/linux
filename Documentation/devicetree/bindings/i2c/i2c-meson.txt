## Documentation/devicetree/bindings/i2c/i2c-meson.txt
```
* Amlogic Meson I2C controller

Required properties:
 - compatible: must be "amlogic,meson6-i2c"
 - reg: physical address and length of the device register set
 - interrupts: a single interrupt specifier
 - clocks: clock for the device
 - #address-cells: should be <1>
 - #size-cells: should be <0>

Optional properties:
- clock-frequency: the desired I2C bus clock frequency in Hz; in
  absence of this property the default value is used (100 kHz).

Example:

	i2c@c1108500 {
		compatible = "amlogic,meson6-i2c";
		reg = <0xc1108500 0x20>;
		interrupts = <0 21 1>;
		clocks = <&clk81>;
		#address-cells = <1>;
		#size-cells = <0>;
	};
```

## Documentation/devicetree/bindings/pinctrl/meson,pinctrl.txt
```
Amlogic Meson pinmux controller

Pins are organized in banks; all banks except AO are controlled by the
same set of registers, while the AO bank uses a dedicated register
range.

The device tree uses sub-nodes to represent set of registers with the
same address space (which are called "domains" in the driver).

Required properties for the root node:
 - compatible: "amlogic,meson8-pinctrl"
 - reg: address and size of registers controlling irq functionality

Required properties for gpio sub-nodes:
 - reg: should contain address and size for mux, pull-enable, pull and
   gpio register sets
 - reg-names: an array of strings describing the "reg" entries. Must
   contain "mux", "pull" and "gpio". "pull-enable" is optional and
   when it is missing the "pull" registers are used instead
 - gpio-controller: identifies the node as a gpio controller
 - #gpio-cells: must be 2

Valid gpio sub-nodes name are:
 - "banks" for the standard banks
 - "ao-bank" for the AO bank which belong to the special always-on
   power domain

Required properties for configuration nodes:
 - pins: the name of a pin group. The list of all available groups is
   available in driver sources.
 - function: the name of a function to activate for the specified set
   of groups. The list of all available functions can be found in
   driver sources.

Example:

	pinctrl: pinctrl@c1109880 {
		compatible = "amlogic,meson8-pinctrl";
		reg = <0xc1109880 0x10>;
		#address-cells = <1>;
		#size-cells = <1>;
		ranges;

		gpio: banks@c11080b0 {
			reg = <0xc11080b0 0x28>,
			      <0xc11080e4 0x18>,
			      <0xc1108120 0x18>,
			      <0xc1108030 0x30>;
			reg-names = "mux", "pull-enable", "pull", "gpio";
			gpio-controller;
			#gpio-cells = <2>;
               };

		gpio_ao: ao-bank@c1108030 {
			reg = <0xc8100014 0x4>,
			      <0xc810002c 0x4>,
			      <0xc8100024 0x8>;
			reg-names = "mux", "pull", "gpio";
			gpio-controller;
			#gpio-cells = <2>;
		};

		nand {
			nand {
				pins = "nand_io", "nand_io_ce0", "nand_io_ce1",
				       "nand_io_rb0", "nand_ale", "nand_cle",
				       "nand_wen_clk", "nand_ren_clk", "nand_dqs",
				       "nand_ce2", "nand_ce3";
				function = "nand";
			};
		};

		uart_ao_a: uart_ao_a {
			uart_ao_a {
				pins = "uart_tx_ao_a", "uart_rx_ao_a";
				       "uart_cts_ao_a", "uart_rts_ao_a";
				function = "uart_ao";
			};
		};
	};
```

## Documentation/devicetree/bindings/serial/amlogic,meson-uart.txt
```
Amlogic Meson UART

Required properties:
- compatible : Should be "amlogic,meson-uart"
- reg : Address and length of the register set
- interrupts : Should contain uart interrupt
- clocks: phandle to the source clock

Example:

uart0: serial@c81004c0 {
	compatible = "amlogic,meson-uart";
	reg = <0xc81004c0 0x14>;
	interrupts = <0 90 1>;
	clocks = <&clk81>;
};
```

## arch/arm/mach-meson/Kconfig
```kconfig
menuconfig ARCH_MESON
	bool "Amlogic Meson SoCs" if ARCH_MULTI_V7
	select GENERIC_IRQ_CHIP
	select HAVE_ARM_SCU if SMP
	select CACHE_L2X0
	select ARM_GIC

if ARCH_MESON

config MACH_MESON6
	bool "Amlogic Meson6 (8726MX) SoCs support"
	default ARCH_MESON
	select MESON6_TIMER

config MACH_MESON8
	bool "Amlogic Meson8 SoCs support"
	select MESON6_TIMER

endif
```
