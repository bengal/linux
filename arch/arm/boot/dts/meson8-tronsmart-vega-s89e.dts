/*
 * Copyright 2014 Beniamino Galvani <b.galvani@gmail.com>
 *
 * This program is free software; you can redistribute it and/or modify it
 * under the terms of the GNU General Public License as published by the
 * Free Software Foundation; either version 2 of the License, or (at your
 * option) any later version.
 */

/dts-v1/;
#include "meson8.dtsi"

/ {
	model = "Tronsmart Vega S89 Elite";
	compatible = "tronsmart,vega-s89e, amlogic,meson8";

	memory {
		reg = <0x40000000 0x80000000>;
	};
};

&uart0 {
	status = "okay";
};
